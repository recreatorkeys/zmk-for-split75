/*
*
* Copyright (c) 2023 Deemen17
* SPDX-License-Identifier: MIT
*
*/

#include "split75.dtsi"
#include <dt-bindings/led/led.h>

/ {
    chosen {
        zmk,battery = &vbatt;
    };
};

/{
    vbatt: vbatt {
        compatible = "zmk,battery-voltage-divider";
        label = "VBATT";
        io-channels = <&adc 0>;
		output-ohms = <2000000>;
		full-ohms = <(2000000 + 820000)>;
    };

    kscan0: kscan {
        compatible = "zmk,kscan-gpio-matrix";
        label = "KSCAN";
        diode-direction = "col2row";

         row-gpios
            = <&gpio0 13 (GPIO_ACTIVE_HIGH | GPIO_PULL_DOWN)>
            , <&gpio0 15 (GPIO_ACTIVE_HIGH | GPIO_PULL_DOWN)>
            , <&gpio0 20 (GPIO_ACTIVE_HIGH | GPIO_PULL_DOWN)>
            , <&gpio0 22 (GPIO_ACTIVE_HIGH | GPIO_PULL_DOWN)>
            , <&gpio1 12 (GPIO_ACTIVE_HIGH | GPIO_PULL_DOWN)>
            ;
            
        col-gpios
            = <&gpio0 30 GPIO_ACTIVE_HIGH>
            , <&gpio0 21 GPIO_ACTIVE_HIGH>
            , <&gpio0 23 GPIO_ACTIVE_HIGH>
            , <&gpio1 9 GPIO_ACTIVE_HIGH>
            , <&gpio0 6 GPIO_ACTIVE_HIGH>
            , <&gpio0 11 GPIO_ACTIVE_HIGH>
            , <&gpio0 12 GPIO_ACTIVE_HIGH>
            , <&gpio0 8 GPIO_ACTIVE_HIGH>
            , <&gpio0 19 GPIO_ACTIVE_HIGH>
            ;
    };

};   

