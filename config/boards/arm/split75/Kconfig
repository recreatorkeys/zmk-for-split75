## config/boards/arm/split75/Kconfig
```kconfig
# SPDX-License-Identifier: MIT

config BOARD_ENABLE_DCDC
	bool "Enable DCDC mode"
	select SOC_DCDC_NRF52X
	default y
	depends on (BOARD_SPLIT75_LEFT || BOARD_SPLIT75_RIGHT)
```

## config/boards/arm/split75/Kconfig.board
```kconfig
#
# Copyright (c) 2023 Deemen17
# SPDX-License-Identifier: MIT
#
config BOARD_SPLIT75_LEFT
	bool "SPLIT75_left"
	depends on SOC_NRF52840_QIAA

config BOARD_SPLIT75_RIGHT
	bool "SPLIT75_right"
	depends on SOC_NRF52840_QIAA
```

## config/boards/arm/split75/Kconfig.defconfig
```kconfig
#
# Copyright (c) 2023 Deemen17
# SPDX-License-Identifier: MIT
#

if BOARD_SPLIT75_LEFT

config ZMK_KEYBOARD_NAME
	default "SPLIT75"

config ZMK_SPLIT
	default y

config ZMK_SPLIT_BLE_ROLE_CENTRAL
	default y

endif # BOARD_SPLIT75_DONGLE

if BOARD_SPLIT75_LEFT || BOARD_SPLIT75_RIGHT

config BOARD
	default "SPLIT75"

config I2C
	bool
	default y

config SPI
    bool
    default y

endif # BOARD_SPLIT75_LEFT || BOARD_SPLIT75_RIGHT

if BOARD_SPLIT75_LEFT || BOARD_SPLIT75_RIGHT

config ZMK_SPLIT
	default y

if USB

config USB_DEVICE_STACK
	default y

if USB_DEVICE_STACK

config USB_NRFX
	default y

endif # USB_DEVICE_STACK

endif # USB

config BT_CTLR
	default BT

endif # BOARD_SPLIT75_LEFT || BOARD_SPLIT75_RIGHT
```

## config/boards/arm/split75/split75_right_defconfig
```kconfig
#
# Copyright (c) 2023 Deemen17
# SPDX-License-Identifier: MIT
#

CONFIG_SOC_SERIES_NRF52X=y
CONFIG_SOC_NRF52840_QIAA=y
CONFIG_BOARD_SPLIT75_RIGHT=y
CONFIG_ZMK_SPLIT=y
CONFIG_ZMK_SLEEP=n
CONFIG_EC11=y
CONFIG_EC11_TRIGGER_GLOBAL_THREAD=y
CONFIG_ZMK_USB=y
CONFIG_ZMK_BLE=y

# Enable MPU
CONFIG_ARM_MPU=y

# Enable GPIO
CONFIG_GPIO=y

# Enable writing to flash
CONFIG_USE_DT_CODE_PARTITION=y
CONFIG_BUILD_OUTPUT_UF2=y

CONFIG_MPU_ALLOW_FLASH_WRITE=y
CONFIG_NVS=y
CONFIG_SETTINGS_NVS=y
CONFIG_FLASH=y
CONFIG_FLASH_PAGE_LAYOUT=y
CONFIG_FLASH_MAP=y

# Enable 32kHz crystal
CONFIG_CLOCK_CONTROL_NRF_K32SRC_XTAL=y
CONFIG_CLOCK_CONTROL_NRF_K32SRC_30PPM=y

# Turn on USB CDC ACM device
CONFIG_USB_DEVICE_STACK=y
CONFIG_USB_CDC_ACM=y
CONFIG_USB_CDC_ACM_RINGBUF_SIZE=1024
```
